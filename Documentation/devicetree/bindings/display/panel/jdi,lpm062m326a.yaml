## Documentation/devicetree/bindings/display/panel/jdi,lpm062m326a.yaml
```yaml
# SPDX-License-Identifier: (GPL-2.0-only OR BSD-2-Clause)
%YAML 1.2
---
$id: http://devicetree.org/schemas/display/panel/jdi,lpm062m326a.yaml#
$schema: http://devicetree.org/meta-schemas/core.yaml#

title: JDI LPM062M326A 720x1280 6.2" DSI video mode panel

maintainers:
  - mojyack <mojyack@gmail.com>

description:
  The 6.2" panel of the Nintendo Switch (Erista). It is a four-lane DSI video
  mode panel. Units ship with panels from several vendors that share this
  compatible and are told apart at runtime by the DCS display ID.

allOf:
  - $ref: panel-common.yaml#

properties:
  compatible:
    const: jdi,lpm062m326a

  reg:
    maxItems: 1

  vdd1-supply:
    description: Positive panel supply (AVDD).

  vdd2-supply:
    description: Negative panel supply (AVEE).

  reset-gpios: true
  backlight: true

required:
  - compatible
  - reg
  - vdd1-supply
  - vdd2-supply

additionalProperties: false

examples:
  - |
    #include <dt-bindings/gpio/gpio.h>

    dsi {
        #address-cells = <1>;
        #size-cells = <0>;

        panel@0 {
            compatible = "jdi,lpm062m326a";
            reg = <0>;

            reset-gpios = <&gpio 170 GPIO_ACTIVE_HIGH>;
            vdd1-supply = <&pavdd>;
            vdd2-supply = <&navdd>;
            backlight = <&backlight>;
        };
    };
...
```

## Documentation/devicetree/bindings/display/panel/nintendo,switch-panel.yaml
```yaml
# SPDX-License-Identifier: (GPL-2.0-only OR BSD-2-Clause)
%YAML 1.2
---
$id: http://devicetree.org/schemas/display/panel/nintendo,switch-panel.yaml#
$schema: http://devicetree.org/meta-schemas/core.yaml#

title: Nintendo Switch 6.2" 720x1280 DSI video mode panel

maintainers:
  - mojyack <mojyack@gmail.com>

description:
  The four-lane DSI video mode LCD of the Nintendo Switch (HAC-001). Consoles
  were assembled with panels from several families, all built around a Himax
  HX8394 controller but each family needing its own power-up and power-down
  sequence - JDI LPM062M326A and LAM062M109A, InnoLux P062CCA (AZ1, AZ2) and
  AUO A062TAN (00, 01, 02). Which one a console carries is not recorded
  anywhere the board description could use, so this compatible describes the
  assembly and the panel is identified at runtime by its DCS display ID.

allOf:
  - $ref: panel-common.yaml#

properties:
  compatible:
    const: nintendo,switch-panel

  reg:
    maxItems: 1

  vddi-supply:
    description: Logic and I/O supply (1.8 V).

  avdd-supply:
    description: Positive analog supply (+5.4 V).

  avee-supply:
    description: Negative analog supply (-5.4 V).

  reset-gpios:
    maxItems: 1
    description:
      Panel reset, active low. The power-up sequence pulses it before the
      display ID is read.

  backlight: true

required:
  - compatible
  - reg
  - vddi-supply
  - avdd-supply
  - avee-supply
  - reset-gpios

additionalProperties: false

examples:
  - |
    #include <dt-bindings/gpio/gpio.h>

    dsi {
        #address-cells = <1>;
        #size-cells = <0>;

        panel@0 {
            compatible = "nintendo,switch-panel";
            reg = <0>;

            reset-gpios = <&gpio 170 GPIO_ACTIVE_LOW>;
            vddi-supply = <&vdd_1v8>;
            avdd-supply = <&pavdd>;
            avee-supply = <&navdd>;
            backlight = <&backlight>;
        };
    };
...
```

## Documentation/devicetree/bindings/iio/light/rohm,bh1730fvc.yaml
```yaml
# SPDX-License-Identifier: (GPL-2.0-only OR BSD-2-Clause)
%YAML 1.2
---
$id: http://devicetree.org/schemas/iio/light/rohm,bh1730fvc.yaml#
$schema: http://devicetree.org/meta-schemas/core.yaml#

title: ROHM BH1730FVC ambient light sensor

maintainers:
  - mojyack <mojyack@gmail.com>

description: |
  I2C ambient light sensor with a visible and an infrared channel, a
  programmable gain, a programmable integration time and an open-drain
  threshold interrupt output.

  Datasheet: https://fscdn.rohm.com/en/products/databook/datasheet/ic/sensor/light/bh1730fvc-e.pdf

properties:
  compatible:
    const: rohm,bh1730fvc

  reg:
    maxItems: 1

  interrupts:
    maxItems: 1

  vcc-supply:
    description: Power supply, VCC pin.

  dvi-supply:
    description: I2C bus I/O voltage, DVI pin.

required:
  - compatible
  - reg
  - vcc-supply
  - dvi-supply

additionalProperties: false

examples:
  - |
    #include <dt-bindings/interrupt-controller/irq.h>

    i2c {
        #address-cells = <1>;
        #size-cells = <0>;

        light-sensor@29 {
            compatible = "rohm,bh1730fvc";
            reg = <0x29>;
            interrupt-parent = <&gpio>;
            interrupts = <17 IRQ_TYPE_LEVEL_LOW>;
            vcc-supply = <&vcc_3v0>;
            dvi-supply = <&vcc_1v8>;
        };
    };
...
```

## Documentation/devicetree/bindings/input/nintendo,joycon-uart.yaml
```yaml
# SPDX-License-Identifier: (GPL-2.0-only OR BSD-2-Clause)
%YAML 1.2
---
$id: http://devicetree.org/schemas/input/nintendo,joycon-uart.yaml#
$schema: http://devicetree.org/meta-schemas/core.yaml#

title: Nintendo Joy-Con rail

maintainers:
  - mojyack <mojyack@gmail.com>

description:
  A side rail of the Nintendo Switch console. A Joy-Con attached to the rail
  speaks the same reports it sends over USB and Bluetooth across an inverted
  1 Mbaud UART, so the rail is described as a serial device attached to the
  host UART it is wired to. Which half is present is discovered at runtime and
  either half can be attached to either rail.

properties:
  compatible:
    const: nintendo,joycon-uart

  charge-gpios:
    maxItems: 1
    description:
      Closes the charge switch of this rail.

  charge-supply:
    description:
      The 5V rail the charge switch feeds from, shared with the other rail
      and with the fan.

required:
  - compatible
  - charge-gpios
  - charge-supply

additionalProperties: false

examples:
  - |
    #include <dt-bindings/gpio/gpio.h>

    serial {
        game-controller {
            compatible = "nintendo,joycon-uart";
            charge-gpios = <&gpio 83 GPIO_ACTIVE_HIGH>;
            charge-supply = <&vdd_5v0>;
        };
    };
...
```

## Documentation/devicetree/bindings/usb/rohm,bm92t.yaml
```yaml
# SPDX-License-Identifier: (GPL-2.0-only OR BSD-2-Clause)
%YAML 1.2
---
$id: http://devicetree.org/schemas/usb/rohm,bm92t.yaml#
$schema: http://devicetree.org/meta-schemas/core.yaml#

title: ROHM BM92T USB Type-C and Power Delivery controller

maintainers:
  - mojyack <mojyack@gmail.com>

description:
  The BM92T family negotiates USB Power Delivery contracts on its own and
  reports the result over I2C. It also carries DisplayPort alternate mode and,
  on the Nintendo Switch, the vendor sequence that drives the dock.

properties:
  compatible:
    const: rohm,bm92t

  reg:
    maxItems: 1

  interrupts:
    maxItems: 1

  pd_bat_chg-supply:
    description:
      Charger input current regulator. It is set to the current the negotiated
      contract allows.

  vbus-supply:
    description: VBUS regulator of the port, enabled while sourcing.

  vbus-source-supply:
    description:
      Regulator feeding VBUS when the port sources power, if it is separate
      from vbus-supply.

  rohm,vconn-en-gpios:
    maxItems: 1
    description: Enables VCONN on the port.

  rohm,dp-disable:
    type: boolean
    description:
      The SBU pins do not carry DisplayPort on this board. Leave alternate mode
      alone.

  rohm,dp-alerts-enable:
    type: boolean
    description:
      Let the controller raise an alert on every DisplayPort status change,
      instead of only reading the status when the port is configured.

  rohm,dp-lanes:
    $ref: /schemas/types.yaml#/definitions/uint32
    description:
      Number of SuperSpeed lanes wired to the DisplayPort source, which selects
      the alternate mode pin assignment.
    enum: [2, 4]
    default: 2

  rohm,dp-signal-toggle-on-resume:
    type: boolean
    description:
      Toggle the dock's DisplayPort signal off and on when resuming, for docks
      whose retimer does not come back on its own.

  rohm,led-static-on-suspend:
    type: boolean
    description:
      Hold the dock LED at a static dim level while suspended rather than
      letting it breathe.

  rohm,dock-power-limit-disable:
    type: boolean
    description:
      Accept the advertised contract as-is instead of applying the Nintendo
      dock power limits when the source identifies itself as a dock.

  rohm,pd-5v-current-limit-ma:
    $ref: /schemas/types.yaml#/definitions/uint32
    description: Charge current limit for a 5V contract, in mA.
    default: 2000

  rohm,pd-9v-current-limit-ma:
    $ref: /schemas/types.yaml#/definitions/uint32
    description: Charge current limit for a 9V contract, in mA.
    default: 2000

  rohm,pd-12v-current-limit-ma:
    $ref: /schemas/types.yaml#/definitions/uint32
    description: Charge current limit for a 12V contract, in mA.
    default: 1500

  rohm,pd-15v-current-limit-ma:
    $ref: /schemas/types.yaml#/definitions/uint32
    description: Charge current limit for a 15V contract, in mA.
    default: 1200

  port:
    $ref: /schemas/graph.yaml#/properties/port
    description:
      Connection to the USB role switch of the controller that owns the port.

required:
  - compatible
  - reg
  - interrupts
  - port

additionalProperties: false

examples:
  - |
    #include <dt-bindings/interrupt-controller/irq.h>

    i2c {
        #address-cells = <1>;
        #size-cells = <0>;

        usb-pd@18 {
            compatible = "rohm,bm92t";
            reg = <0x18>;
            interrupt-parent = <&gpio>;
            interrupts = <84 IRQ_TYPE_LEVEL_LOW>;

            pd_bat_chg-supply = <&charge_current>;
            vbus-supply = <&usb_otg_vbus>;

            rohm,dp-lanes = <2>;
            rohm,pd-15v-current-limit-ma = <1200>;

            port {
                endpoint {
                    remote-endpoint = <&usb2_0_ep>;
                };
            };
        };
    };
...
```

## Documentation/devicetree/bindings/usb/rohm,bm92t36.yaml
```yaml
# SPDX-License-Identifier: (GPL-2.0-only OR BSD-2-Clause)
%YAML 1.2
---
$id: http://devicetree.org/schemas/usb/rohm,bm92t36.yaml#
$schema: http://devicetree.org/meta-schemas/core.yaml#

title: ROHM BM92T36 USB Type-C and Power Delivery controller

maintainers:
  - mojyack <mojyack@gmail.com>

description: |
  The BM92T36 is a dual-role USB Type-C port controller with an integrated
  USB Power Delivery 2.0 engine. It detects attach and orientation and
  negotiates an initial contract by itself; contract requests, data role
  swaps, VDMs and DisplayPort alternate mode entry are commands from the
  host. Once DisplayPort is configured the controller drives the SuperSpeed
  and SBU paths and the hot plug signal itself. Its alert line is level
  triggered and active low.

  The port's roles, its source capabilities and the sink capabilities it
  advertises are provisioned in the part and cannot be changed by the
  host. The connector describes what the board can take, which the host
  uses for its own contract requests and for the charger's input limit.

properties:
  compatible:
    const: rohm,bm92t36

  reg:
    maxItems: 1

  interrupts:
    maxItems: 1

  connector:
    type: object
    $ref: /schemas/connector/usb-connector.yaml#
    unevaluatedProperties: false
    description:
      The Type-C connector, a dual-role power and data port without a
      preferred role. sink-pdos lists the fixed and variable supplies the
      board can take, fixed 5 V first. The controller negotiates within the
      sink capabilities provisioned in it before the host runs, so sink-pdos
      must cover each of them at no less current, a fixed one by a fixed
      supply at its voltage or a variable supply spanning it and a variable
      one by a variable supply spanning its range. op-sink-microwatt is
      the power the board needs to operate, and a source that cannot offer it
      gets a request with Capability Mismatch set. vbus-supply sources VBUS
      in the source role, at the source capabilities provisioned in the
      controller. The DisplayPort alternate mode under altmodes, a DFP_D,
      gives the pin assignments the board is wired for. port@0 leads to the
      USB role switch of the high-speed path; the SuperSpeed and SBU paths
      are switched by the controller and have no host-controlled endpoint.

    properties:
      compatible:
        const: usb-c-connector

      power-role:
        const: dual

      data-role:
        const: dual

      try-power-role: false

      source-pdos: false

    required:
      - power-role
      - data-role
      - sink-pdos
      - op-sink-microwatt
      - ports

required:
  - compatible
  - reg
  - interrupts
  - connector

additionalProperties: false

examples:
  - |
    #include <dt-bindings/interrupt-controller/irq.h>
    #include <dt-bindings/usb/pd.h>

    i2c {
        #address-cells = <1>;
        #size-cells = <0>;

        typec@18 {
            compatible = "rohm,bm92t36";
            reg = <0x18>;
            interrupt-parent = <&gpio>;
            interrupts = <84 IRQ_TYPE_LEVEL_LOW>;

            connector {
                compatible = "usb-c-connector";
                label = "USB-C";
                power-role = "dual";
                data-role = "dual";
                vbus-supply = <&usb_otg_vbus>;
                sink-pdos = <PDO_FIXED(5000, 2000, PDO_FIXED_USB_COMM)
                             PDO_FIXED(9000, 2000, 0)
                             PDO_FIXED(12000, 1500, 0)
                             PDO_FIXED(15000, 1200, 0)
                             PDO_VAR(5000, 15000, 1200)>;
                op-sink-microwatt = <10000000>;

                altmodes {
                    displayport {
                        svid = /bits/ 16 <0xff01>;
                        /* DFP_D, receptacle, pin assignment D */
                        vdo = <0x00000846>;
                    };
                };

                ports {
                    #address-cells = <1>;
                    #size-cells = <0>;

                    port@0 {
                        reg = <0>;

                        endpoint {
                            remote-endpoint = <&usb2_0_ep>;
                        };
                    };
                };
            };
        };
    };
...
```
