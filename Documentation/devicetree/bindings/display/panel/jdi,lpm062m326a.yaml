## drivers/gpu/drm/tegra/Kconfig
```kconfig
# SPDX-License-Identifier: GPL-2.0-only
config DRM_TEGRA
	tristate "NVIDIA Tegra DRM"
	depends on ARCH_TEGRA || COMPILE_TEST
	depends on COMMON_CLK
	depends on DRM
	depends on OF
	select DRM_CLIENT_SELECTION
	select DRM_DISPLAY_DP_HELPER
	select DRM_DISPLAY_HDMI_HELPER
	select DRM_DISPLAY_HELPER
	select DRM_BRIDGE_CONNECTOR
	select DRM_DISPLAY_DP_AUX_BUS
	select DRM_KMS_HELPER
	select DRM_MIPI_DSI
	select DRM_PANEL
	select FB_DMAMEM_HELPERS if DRM_FBDEV_EMULATION
	select TEGRA_HOST1X
	select INTERCONNECT
	select IOMMU_IOVA
	select CEC_CORE if CEC_NOTIFIER
	select SND_SIMPLE_CARD if SND_SOC_TEGRA20_SPDIF
	select SND_SOC_HDMI_CODEC if SND_SOC_TEGRA20_SPDIF
	select SND_AUDIO_GRAPH_CARD if SND_SOC_TEGRA20_SPDIF
	help
	  Choose this option if you have an NVIDIA Tegra SoC.

	  To compile this driver as a module, choose M here: the module
	  will be called tegra-drm.

if DRM_TEGRA

config DRM_TEGRA_DEBUG
	bool "NVIDIA Tegra DRM debug support"
	help
	  Say yes here to enable debugging support.

config DRM_TEGRA_STAGING
	bool "Enable HOST1X interface"
	depends on STAGING
	help
	  Say yes if HOST1X should be available for userspace DRM users.

	  If unsure, choose N.

config DRM_TEGRA_NVDEC_V4L2
	bool "Tegra210 NVDEC stateless video decoder (V4L2)"
	depends on VIDEO_DEV
	depends on DRM_TEGRA=m || VIDEO_DEV=y
	select MEDIA_CONTROLLER
	select MEDIA_CONTROLLER_REQUEST_API
	select V4L2_MEM2MEM_DEV
	select VIDEOBUF2_DMA_SG
	help
	  Expose the Tegra210 NVDEC engine as a stateless V4L2 memory-to-memory
	  decoder. VIC detiles every picture into linear NV12, or P010 for
	  10-bit HEVC. Coded formats:

	    - H.264 up to High, including interlaced pictures
	    - HEVC Main and Main10

	  It needs NVIDIA's firmware, nvidia/tegra210/vic04_ucode.bin and
	  nvidia/tegra210/nvdec.bin. The latter is not in linux-firmware; it
	  was tested with nvhost_nvdec020_ns.fw from the L4T R32.7 BSP, sha256
	  7b5ac5ad66dad47e77f2a056991e422dd2630fa17e0a57a5874af492efa0f909.

	  If unsure, choose N.

endif
```
